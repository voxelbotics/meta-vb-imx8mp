## conf/machine/imx8mpnavq.conf
```bitbake
#@TYPE: Machine
#@NAME: Emcraft Systems i.MX8MP 2GB LPDDR4 SOM
#@SOC: i.MX8MP
#@DESCRIPTION: Machine configuration for Emcraft Systems i.MX8MP 2GB LPDDR4 SOM
#@MAINTAINER: Emcraft Systems <customer-service@emcraft.com>

MACHINE="imx8mpnavq"

MACHINEOVERRIDES =. "mx8mpnavq:"
require conf/machine/imx8mp-lpddr4-evk.conf

MACHINE_FEATURES += " pci wifi bluetooth bcm43455"

KERNEL_DEVICETREE_BASENAME = "imx8mp-navq"
KERNEL_DEVICETREE = "freescale/${KERNEL_DEVICETREE_BASENAME}.dtb"
KERNEL_DEVICETREE += "freescale/${KERNEL_DEVICETREE_BASENAME}-uart4.dtb"

UBOOT_CONFIG ??= "sd"
UBOOT_CONFIG_BASENAME = "navqp"
UBOOT_CONFIG[fspi]    = "${UBOOT_CONFIG_BASENAME}_defconfig"
UBOOT_CONFIG[sd]      = "${UBOOT_CONFIG_BASENAME}_defconfig,sdcard"
UBOOT_CONFIG[ecc]     = "${UBOOT_CONFIG_BASENAME}_inline_ecc_defconfig"
UBOOT_CONFIG[mfgtool] = "${UBOOT_CONFIG_BASENAME}_defconfig"

# Set DDR FIRMWARE
DDR_FIRMWARE_VERSION = "202006"
DDR_FIRMWARE_NAME = " \
	lpddr4_pmu_train_1d_dmem_${DDR_FIRMWARE_VERSION}.bin \
	lpddr4_pmu_train_1d_imem_${DDR_FIRMWARE_VERSION}.bin \
	lpddr4_pmu_train_2d_dmem_${DDR_FIRMWARE_VERSION}.bin \
	lpddr4_pmu_train_2d_imem_${DDR_FIRMWARE_VERSION}.bin \
"

# Set u-boot DTB
UBOOT_DTB_NAME = "navqp.dtb"

# Set imx-mkimage boot target
IMXBOOT_TARGETS = "flash_evk"

# Set Serial console
SERIAL_CONSOLES = "115200;ttymxc1"

IMAGE_BOOTLOADER = "imx-boot"

LOADADDR = ""
UBOOT_SUFFIX = "bin"
UBOOT_MAKE_TARGET = ""
IMX_BOOT_SEEK = "32"

OPTEE_BIN_EXT = "8mp"

# Add additional firmware
#MACHINE_FIRMWARE_append = " linux-firmware-ath10

IMXBOOT_TARGETS_BASENAME = "flash_evk"

SWU_HWCOMPAT = "1.0"
SWU_BOARD = "${MACHINE}"
SWU_UBOOT_VERSION = "6.1.22.0"
```

## conf/machine/imx8mpnavqdesktop.conf
```bitbake
MACHINE="imx8mpnavq"
require conf/machine/imx8mpnavq.conf

require conf/machine/include/ubuntubasics.inc
```

## conf/machine/navqplusdesktop.conf
```bitbake
MACHINE="navqplus"
require conf/machine/navqplus.conf

require conf/machine/include/ubuntubasics.inc
```
